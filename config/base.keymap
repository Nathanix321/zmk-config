#include <behaviors.dtsi>
#include <behaviors/num_word.dtsi> // Requires auto-layer module.
#include <dt-bindings/zmk/keys.h>
#include <dt-bindings/zmk/bt.h>
#include <dt-bindings/zmk/outputs.h>

#include "zmk-helpers/helper.h"

#define ALPHA1    0
#define ALPHA2    1
#define NUM       2
#define NAV       3
#define MOUSE     4
#define SYM       5
#define FUN       6

/* Global defaults */

#define QUICK_TAP_MS 175

&sk {
    release-after-ms = <900>;
    quick-release;
};

&sl { // Allow sticky mods to chord across sticky layers.
    release-after-ms = <2000>;
    ignore-modifiers;
};

&lt {
    flavor = "balanced";
    tapping-term-ms = <200>;
    quick-tap-ms = <0>;
};

/* Homerow mods */

#define KEYS_L LT0 LT1 LT2 LT3 LT4 LM0 LM1 LM2 LM3 LM4 LB0 LB1 LB2 LB3 LB4
#define KEYS_R RT0 RT1 RT2 RT3 RT4 RM0 RM1 RM2 RM3 RM4 RB0 RB1 RB2 RB3 RB4
#define THUMBS LH2 LH1 LH0 RH0 RH1 RH2

#define MAKE_HRM(NAME, HOLD, TAP, TRIGGER_POS)                                   \
    ZMK_HOLD_TAP(NAME, bindings = <HOLD>, <TAP>; flavor = "balanced";            \
               tapping-term-ms = <280>; quick-tap-ms = <QUICK_TAP_MS>;           \
               require-prior-idle-ms = <150>; hold-trigger-on-release;           \
               hold-trigger-key-positions = <TRIGGER_POS>;)

MAKE_HRM(hml, &kp, &kp, KEYS_R THUMBS) // Left-hand HRMs.
MAKE_HRM(hmr, &kp, &kp, KEYS_L THUMBS) // Right-hand HRMs.

// Hack: Make HRM combos tap-only (cf, ZMK issue #544).
#define ZMK_COMBO_8(NAME, TAP, POS, LAYERS, COMBO_MS, IDLE_MS, HOLD, SIDE)       \
    MAKE_HRM(hm_combo_##NAME, &kp, TAP, SIDE THUMBS)                             \
    ZMK_COMBO_6(NAME, &hm_combo_##NAME HOLD 0, POS, LAYERS, COMBO_MS, IDLE_MS)

/* Combos, mouse emulation */

#include "combos.dtsi" // Must be sourced after HRM-combo hack.
#include "mouse.dtsi"

/* Nav cluster */

// Trigger tap-action on all interrupts.
#define MT_CORE                                                                  \
    flavor = "tap-preferred";                                                    \
    tapping-term-ms = <220>;                                                     \
    quick-tap-ms = <0>;                                                          \
    hold-trigger-key-positions = <0>;

&mt { MT_CORE };

#ifdef UNDO
    #undef UNDO
#endif
#ifdef REDO
    #undef REDO
#endif
#ifdef CUT
    #undef CUT
#endif
#ifdef COPY
    #undef COPY
#endif
#ifdef PASTE
    #undef PASTE
#endif

#define UNDO  &kp LC(Z)
#define REDO  &kp LC(Y)
#define CUT   &kp LC(X)
#define COPY  &kp LC(C)
#define PASTE &kp LC(V)

/* Arcane keys & auto-layers */
#define ARCANE_L_NAV &arcane_l_nav NAV 0
ZMK_HOLD_TAP(arcane_l_nav, bindings = <&mo>, <&arcane_l>;
             flavor = "hold-preferred"; tapping-term-ms = <200>;
             quick-tap-ms = <QUICK_TAP_MS>;)

ZMK_ADAPTIVE_KEY(
    arcane_l, bindings = <&none>;
    repeat   { strict-modifiers; trigger-keys = <A E H I O Q T U X Y Z DOT>; max-prior-idle-ms = <2000>; bindings = <&key_repeat>;                                  }; // |REPEAT|
    kp_b     { strict-modifiers; trigger-keys = <B>;                         max-prior-idle-ms = <2000>; bindings = <&kp E &kp C &kp A &kp U &kp S &kp E &kp SPACE>;}; // |ECAUSE |
    kp_c     { strict-modifiers; trigger-keys = <C>;                         max-prior-idle-ms = <2000>; bindings = <&kp K>;                                        }; // |K|
    kp_d     { strict-modifiers; trigger-keys = <D>;                         max-prior-idle-ms = <2000>; bindings = <&kp BSPC &kp C &kp D &kp SPACE>;               }; // |CD |
    kp_f     { strict-modifiers; trigger-keys = <F>;                         max-prior-idle-ms = <2000>; bindings = <&kp O &kp R>;                                  }; // |OR|
    kp_g     { strict-modifiers; trigger-keys = <G>;                         max-prior-idle-ms = <2000>; bindings = <&kp E &kp N &kp E &kp R &kp A &kp L>;          }; // |ENERAL|
    kp_j     { strict-modifiers; trigger-keys = <J>;                         max-prior-idle-ms = <2000>; bindings = <&kp U &kp S &kp T>;                            }; // |UST|
    kp_l     { strict-modifiers; trigger-keys = <L>;                         max-prior-idle-ms = <2000>; bindings = <&kp K>;                                        }; // |K|
    kp_m     { trigger-keys = <M>;                         max-prior-idle-ms = <2000>; bindings = <&kp E &kp N &kp T>;                            }; // |ENT|
    kp_n     { strict-modifiers; trigger-keys = <N>;                         max-prior-idle-ms = <2000>; bindings = <&kp I &kp O &kp N>;                            }; // |ION|
    kp_p     { strict-modifiers; trigger-keys = <P>;                         max-prior-idle-ms = <2000>; bindings = <&kp R &kp E &kp T &kp T &kp Y>;                }; // |RETTY|
    kp_r     { strict-modifiers; trigger-keys = <R>;                         max-prior-idle-ms = <2000>; bindings = <&kp M>;                                        }; // |M|
    kp_s     { strict-modifiers; trigger-keys = <S>;                         max-prior-idle-ms = <2000>; bindings = <&kp K>;                                        }; // |K|
    kp_w     { strict-modifiers; trigger-keys = <W>;                         max-prior-idle-ms = <2000>; bindings = <&kp H &kp I &kp C &kp H>;                      }; // |HICH|
    kp_pound { strict-modifiers; trigger-keys = <POUND>;                     max-prior-idle-ms = <2000>; bindings = <&kp D &kp E &kp F &kp I &kp N &kp E &kp SPACE>;}; // |DEFINE |
)

#define ARCANE_R_ALPHA2 &arcane_r_alpha2 ALPHA2 0
ZMK_HOLD_TAP(arcane_r_alpha2, bindings = <&mo>, <&arcane_r>;
             flavor = "hold-preferred"; tapping-term-ms = <200>;
             quick-tap-ms = <QUICK_TAP_MS>;)

ZMK_ADAPTIVE_KEY(
    arcane_r, bindings = <&none>;
    repeat   { strict-modifiers; trigger-keys = <B C D F G J K L M N P R S V W>; max-prior-idle-ms = <2000>; bindings = <&key_repeat>;                                        }; // |REPEAT|
    kp_a     { strict-modifiers; trigger-keys = <A>;                             max-prior-idle-ms = <2000>; bindings = <&kp N &kp D &kp SPACE>;                              }; // |ND |
    kp_e     { strict-modifiers; trigger-keys = <E>;                             max-prior-idle-ms = <2000>; bindings = <&kp U>;                                              }; // |U|
    kp_i     { strict-modifiers; trigger-keys = <I>;                             max-prior-idle-ms = <2000>; bindings = <&kp O &kp N>;                                        }; // |ON|
    kp_o     { strict-modifiers; trigger-keys = <O>;                             max-prior-idle-ms = <2000>; bindings = <&kp I>;                                              }; // |I|
    kp_q     { strict-modifiers; trigger-keys = <Q>;                             max-prior-idle-ms = <2000>; bindings = <&kp U &kp E &kp E &kp N>;                            }; // |UEEN|
    kp_t     { strict-modifiers; trigger-keys = <T>;                             max-prior-idle-ms = <2000>; bindings = <&kp M &kp E &kp N &kp T>;                            }; // |MENT|
    kp_y     { strict-modifiers; trigger-keys = <Y>;                             max-prior-idle-ms = <2000>; bindings = <&kp E &kp A &kp H>;                                  }; // |EAH|
    kp_space { strict-modifiers; trigger-keys = <SPACE>;                         max-prior-idle-ms = <2000>; bindings = <&kp T &kp H &kp E &kp SPACE>;                        }; // |THE |
    kp_dot   { strict-modifiers; trigger-keys = <DOT>;                           max-prior-idle-ms = <2000>; bindings = <&kp FSLH>;                                           }; // |/|
    kp_comma { strict-modifiers; trigger-keys = <COMMA>;                         max-prior-idle-ms = <2000>; bindings = <&kp SPACE &kp B &kp U &kp T &kp SPACE>;              }; // | BUT |
    kp_pound { strict-modifiers; trigger-keys = <POUND>;                         max-prior-idle-ms = <2000>; bindings = <&kp I &kp N &kp C &kp L &kp U &kp D &kp E &kp SPACE>;}; // |INCLUDE |
)

#define HML_AK_H &hml_ak_h LGUI 0
ZMK_HOLD_TAP(hml_ak_h, bindings = <&kp>, <&ak_h>; flavor = "balanced";
            tapping-term-ms = <280>; quick-tap-ms = <QUICK_TAP_MS>;
            require-prior-idle-ms = <150>; hold-trigger-on-release;
            hold-trigger-key-positions = <KEYS_R THUMBS>;)
ZMK_ADAPTIVE_KEY(
   ak_h, bindings = <&kp H>;
   kp_ah { strict-modifiers; trigger-keys = <A>; max-prior-idle-ms = <300>; bindings = <&kp U>; };
   kp_eh { strict-modifiers; trigger-keys = <U>; max-prior-idle-ms = <300>; bindings = <&kp A>; };
   kp_uh { strict-modifiers; trigger-keys = <E>; max-prior-idle-ms = <300>; bindings = <&kp O>; };
   kp_oh { strict-modifiers; trigger-keys = <O>; max-prior-idle-ms = <300>; bindings = <&kp E>; };
   kp_rh { strict-modifiers; trigger-keys = <R>; max-prior-idle-ms = <300>; bindings = <&kp N>; };
)

// Tap: num-word | Hold: num-layer.
#define CAPS_NUM &smart_num NUM 0
ZMK_HOLD_TAP(smart_num, bindings = <&mo>, <&caps_word>; flavor = "balanced";
             tapping-term-ms = <200>; quick-tap-ms = <QUICK_TAP_MS>;)

// Smart-mouse, requires tri-state module.
ZMK_TRI_STATE(
    smart_mouse, bindings = <&tog MOUSE>, <&none>, <&tog MOUSE>;
    ignored-key-positions =
        <LT4 LT3 LT2 LT1 LT0 LM4 LM3 LM2 LM1 LM0 LB4 LB3 LB2 LB1 LB0 LH2 LH1 LH0 RM1 RM2 RM3 RM4 RB1 RB3 RH0 RH1 RH2>;
    ignored-layers = <MOUSE NAV FUN>;)
/* Custom behaviors */

// Define mod-morph with a *single* mod trigger for less repetition.
#define SIMPLE_MORPH(NAME, MOD, BINDING1, BINDING2)                            \
    ZMK_MOD_MORPH(NAME, mods = <(MOD_L##MOD | MOD_R##MOD)>;                      \
                bindings = <BINDING1>, <BINDING2>;)

// Tap: comma | Shift + tap: semicolon.
SIMPLE_MORPH(comma_morph, SFT, &kp COMMA, &kp SEMICOLON)

// Tap: dot | Shift + tap: colon.
#define HML_DOT_MORPH &hml_dot_morph LSHFT 0
ZMK_HOLD_TAP(hml_dot_morph, bindings = <&kp>, <&dot_morph>; flavor = "balanced";
            tapping-term-ms = <280>; quick-tap-ms = <QUICK_TAP_MS>;
            require-prior-idle-ms = <150>; hold-trigger-on-release;
            hold-trigger-key-positions = <KEYS_R THUMBS>;)
SIMPLE_MORPH(dot_morph, SFT, &kp DOT, &kp COLON)

#define HML_REPEAT &hml_repeat LGUI 0
ZMK_HOLD_TAP(hml_repeat, bindings = <&kp>, <&key_repeat>; flavor = "balanced";
            tapping-term-ms = <280>; quick-tap-ms = <QUICK_TAP_MS>;
            require-prior-idle-ms = <150>; hold-trigger-on-release;
            hold-trigger-key-positions = <KEYS_R THUMBS>;)

#define HMR_REPEAT &hmr_repeat LGUI 0
ZMK_HOLD_TAP(hmr_repeat, bindings = <&kp>, <&key_repeat>; flavor = "balanced";
            tapping-term-ms = <280>; quick-tap-ms = <QUICK_TAP_MS>;
            require-prior-idle-ms = <150>; hold-trigger-on-release;
            hold-trigger-key-positions = <KEYS_L THUMBS>;)

// Tap: question mark | Shift + tap: exclamation point.
SIMPLE_MORPH(qexcl_morph, SFT, &kp QMARK, &kp EXCL)

// Macros
ZMK_MACRO(macro_1,
    wait-ms = <30>;
    tap-ms = <1>;
    bindings = <&kp L &kp E &kp T &kp O &kp U &kp R &kp N &kp E &kp A &kp U &kp DOT &kp N &kp A &kp T &kp H &kp A &kp N &kp I &kp E &kp L &kp AT &kp H &kp O &kp T &kp M &kp A &kp I &kp L &kp DOT &kp C &kp O &kp M>;
)

ZMK_MACRO(macro_2,
    wait-ms = <30>;
    tap-ms = <1>;
    bindings = <&kp L &kp E &kp T &kp N &kp N1 &kp N1 &kp N0 &kp N2 &kp AT &kp U &kp S &kp H &kp E &kp R &kp B &kp R &kp O &kp O &kp K &kp E &kp DOT &kp C &kp A>;
)

ZMK_MACRO(macro_3,
    wait-ms = <30>;
    tap-ms = <1>;
    bindings = <&kp N &kp A &kp T &kp H &kp A &kp N &kp I &kp E &kp L &kp DOT &kp L &kp E &kp T &kp O &kp U &kp R &kp N &kp E &kp A &kp U &kp AT &kp S &kp B &kp Q &kp U &kp A &kp N &kp T &kp U &kp M &kp DOT &kp C &kp O &kp M>;
)

/* Keymap */

#ifndef ZMK_BASE_LAYER
    #define ZMK_BASE_LAYER(name, LT, RT, LM, RM, LB, RB, LH, RH)                 \
        ZMK_LAYER(name, LT RT LM RM LB RB LH RH)
#endif

ZMK_BASE_LAYER(Alpha1,
//╭─────────────────┬─────────────────┬─────────────────┬─────────────────┬────────────────────╮ ╭────────────────────┬─────────────────┬─────────────────┬─────────────────┬─────────────────╮
    &kp Q             &kp Y             &kp O             &kp U             &kp MINUS          ,   &kp J                &kp G             &kp N             &kp W             &kp K           ,
//├─────────────────┼─────────────────┼─────────────────┼─────────────────┼────────────────────┤ ├────────────────────┼─────────────────┼─────────────────┼─────────────────┼─────────────────┤
    HML_AK_H          &hml LALT I       &hml LCTRL E      &hml LSHFT A      &dot_morph         ,   &kp P                &hmr LSHFT D      &hmr LCTRL R      &hmr LALT S       &hmr LGUI L     ,
//├─────────────────┼─────────────────┼─────────────────┼─────────────────┼────────────────────┤ ├────────────────────┼─────────────────┼─────────────────┼─────────────────┼─────────────────┤
    &kp X             &qexcl_morph      &kp APOS          &comma_morph      &kp Z              ,   &kp B                &kp C             &kp M             &kp F             &kp V           ,
//╰─────────────────┴─────────────────┼─────────────────┼─────────────────┼────────────────────┤ ├────────────────────┼─────────────────┼─────────────────┼─────────────────┴─────────────────╯
                                        CAPS_NUM          &mt LSHFT SPACE   ARCANE_L_NAV       ,   ARCANE_R_ALPHA2      &lt SYM T         &lt FUN BSPC
//                                    ╰─────────────────┴─────────────────┴────────────────────╯ ╰────────────────────┴─────────────────┴─────────────────╯
)

ZMK_BASE_LAYER(Alpha2,
//╭─────────────────┬─────────────────┬─────────────────┬─────────────────┬────────────────────╮ ╭────────────────────┬─────────────────┬─────────────────┬─────────────────┬─────────────────╮
    &none             &none             &kp RA(O)         &kp RA(D)         &none              ,   &none                &kp J             &kp RA(D)         &kp RA(J)         &key_repeat     ,
//├─────────────────┼─────────────────┼─────────────────┼─────────────────┼────────────────────┤ ├────────────────────┼─────────────────┼─────────────────┼─────────────────┼─────────────────┤
    &kp LGUI          &hml LALT RA(I)   &hml LCTRL RA(E)  &hml LSHFT RA(A)  &none              ,   &none                &hmr LSHFT P      &hmr LCTRL RA(W)  &hmr LALT RA(U)   HMR_REPEAT      ,
//├─────────────────┼─────────────────┼─────────────────┼─────────────────┼────────────────────┤ ├────────────────────┼─────────────────┼─────────────────┼─────────────────┼─────────────────┤
    &key_repeat       &kp RA(K)         &kp RA(R)         &kp Z             &none              ,   &none                &kp B             &kp RA(C)         &kp RA(Y)         &key_repeat     ,
//╰─────────────────┴─────────────────┼─────────────────┼─────────────────┼────────────────────┤ ├────────────────────┼─────────────────┼─────────────────┼─────────────────┴─────────────────╯
                                        &kp BSPC          &mt LSHFT SPACE   &arcane_l          ,   &none                &none             &none
//                                    ╰─────────────────┴─────────────────┴────────────────────╯ ╰────────────────────┴─────────────────┴─────────────────╯
)

ZMK_BASE_LAYER(Num,
//╭─────────────────┬─────────────────┬─────────────────┬─────────────────┬────────────────────╮ ╭────────────────────┬─────────────────┬─────────────────┬─────────────────┬─────────────────╮
    &none             &none             &none             &none             &none              ,   &kp STAR             &kp N7            &kp N8            &kp N9            &comma_morph    ,
//├─────────────────┼─────────────────┼─────────────────┼─────────────────┼────────────────────┤ ├────────────────────┼─────────────────┼─────────────────┼─────────────────┼─────────────────┤
    &kp LGUI          &kp LALT          &kp LCTRL         &kp LSHFT         &none              ,   &kp PLUS             &kp N4            &kp N5            &kp N6            &dot_morph      ,
//├─────────────────┼─────────────────┼─────────────────┼─────────────────┼────────────────────┤ ├────────────────────┼─────────────────┼─────────────────┼─────────────────┼─────────────────┤
    &none             &none             &none             &none             &none              ,   &kp MINUS            &kp N1            &kp N2            &kp N3            &kp FSLH        ,
//╰─────────────────┴─────────────────┼─────────────────┼─────────────────┼────────────────────┤ ├────────────────────┼─────────────────┼─────────────────┼─────────────────┴─────────────────╯
                                        &none             &mt LSHFT SPACE   &none              ,   &kp EQUAL            &kp N0            &kp BSPC
//                                    ╰─────────────────┴─────────────────┴────────────────────╯ ╰────────────────────┴─────────────────┴─────────────────╯
)

ZMK_BASE_LAYER(Nav,
//╭─────────────────┬─────────────────┬─────────────────┬─────────────────┬────────────────────╮ ╭────────────────────┬─────────────────┬─────────────────┬─────────────────┬─────────────────╮
    UNDO              CUT               COPY              PASTE             REDO               ,   &none                &none             &none             &none             &none           ,
//├─────────────────┼─────────────────┼─────────────────┼─────────────────┼────────────────────┤ ├────────────────────┼─────────────────┼─────────────────┼─────────────────┼─────────────────┤
    &kp LEFT          &kp DOWN          &kp UP            &kp RIGHT         &kp CAPS           ,   &none                &kp LSHFT         &kp LCTRL         &kp LALT          &kp LGUI        ,
//├─────────────────┼─────────────────┼─────────────────┼─────────────────┼────────────────────┤ ├────────────────────┼─────────────────┼─────────────────┼─────────────────┼─────────────────┤
    &kp HOME          &kp PG_DN         &kp PG_UP         &kp END           &kp INS            ,   &none                &none             &none             &none             &none           ,
//╰─────────────────┴─────────────────┼─────────────────┼─────────────────┼────────────────────┤ ├────────────────────┼─────────────────┼─────────────────┼─────────────────┴─────────────────╯
                                        &none             &none             &none              ,   &none                &mt LSHFT SPACE   &kp BSPC
//                                    ╰─────────────────┴─────────────────┴────────────────────╯ ╰────────────────────┴─────────────────┴─────────────────╯
)

ZMK_BASE_LAYER(Mouse,
//╭─────────────────┬─────────────────┬─────────────────┬─────────────────┬────────────────────╮ ╭────────────────────┬─────────────────┬─────────────────┬─────────────────┬─────────────────╮
    UNDO              CUT               COPY              PASTE             REDO               ,   &none                &none             &none             &none             &none           ,
//├─────────────────┼─────────────────┼─────────────────┼─────────────────┼────────────────────┤ ├────────────────────┼─────────────────┼─────────────────┼─────────────────┼─────────────────┤
    U_MS_L            U_MS_D            U_MS_U            U_MS_R            &kp CAPS           ,   &none                &kp LSHFT         &kp LCTRL         &kp LALT          &kp LGUI        ,
//├─────────────────┼─────────────────┼─────────────────┼─────────────────┼────────────────────┤ ├────────────────────┼─────────────────┼─────────────────┼─────────────────┼─────────────────┤
    U_WH_L            U_WH_D            U_WH_U            U_WH_R            &kp INS            ,   &none                &none             &none             &none             &none           ,
//╰─────────────────┴─────────────────┼─────────────────┼─────────────────┼────────────────────┤ ├────────────────────┼─────────────────┼─────────────────┼─────────────────┴─────────────────╯
                                        &kp BSPC          &mt LSHFT SPACE   &none              ,   &mkp MCLK            &mkp LCLK         &mkp RCLK
//                                    ╰─────────────────┴─────────────────┴────────────────────╯ ╰────────────────────┴─────────────────┴─────────────────╯
)

ZMK_BASE_LAYER(Sym,
//╭─────────────────┬─────────────────┬─────────────────┬─────────────────┬────────────────────╮ ╭────────────────────┬─────────────────┬─────────────────┬─────────────────┬─────────────────╮
    &kp GRAVE         &kp LT            &kp GT            &kp MINUS         &kp PIPE           ,   &kp CARET            &kp LBRC          &kp RBRC          &kp AMPS          &kp BSLH        ,
//├─────────────────┼─────────────────┼─────────────────┼─────────────────┼────────────────────┤ ├────────────────────┼─────────────────┼─────────────────┼─────────────────┼─────────────────┤
    &hml LGUI EXCL    &hml LALT STAR    &hml LCTRL FSLH   &hml LSHFT EQUAL  &kp AMPS           ,   &kp POUND            &hmr LSHFT LPAR   &hmr LCTRL RPAR   &hmr LALT SEMI    &hmr LGUI DQT   ,
//├─────────────────┼─────────────────┼─────────────────┼─────────────────┼────────────────────┤ ├────────────────────┼─────────────────┼─────────────────┼─────────────────┼─────────────────┤
    &kp TILDE         &kp PLUS          &kp LBKT          &kp RBKT          &kp PERCENT        ,   &kp AT               &kp COLON         &kp COMMA         &kp DOT           &kp APOS        ,
//╰─────────────────┴─────────────────┼─────────────────┼─────────────────┼────────────────────┤ ├────────────────────┼─────────────────┼─────────────────┼─────────────────┴─────────────────╯
                                        &kp BSPC          &mt LSHFT SPACE   &none              ,   &none                &none             &none
//                                    ╰─────────────────┴─────────────────┴────────────────────╯ ╰────────────────────┴─────────────────┴─────────────────╯
)

ZMK_BASE_LAYER(Fun,
//╭─────────────────┬─────────────────┬─────────────────┬─────────────────┬────────────────────╮ ╭────────────────────┬─────────────────┬─────────────────┬─────────────────┬─────────────────╮
    &macro_1          &macro_2          &macro_3          &none             &none              ,   &none                &kp F7            &kp F8           &kp F9             &kp F12         ,
//├─────────────────┼─────────────────┼─────────────────┼─────────────────┼────────────────────┤ ├────────────────────┼─────────────────┼─────────────────┼─────────────────┼─────────────────┤
    &kp C_PREV        &kp C_VOL_DN      &kp C_VOL_UP      &kp C_NEXT        &none              ,   &none                &kp F4            &kp F5           &kp F6             &kp F11         ,
//├─────────────────┼─────────────────┼─────────────────┼─────────────────┼────────────────────┤ ├────────────────────┼─────────────────┼─────────────────┼─────────────────┼─────────────────┤
    &bt BT_SEL 0      &bt BT_SEL 1      &bt BT_SEL 2      &bt BT_SEL 3      &bt BT_CLR         ,   &none                &kp F1            &kp F2           &kp F3             &kp F10         ,
//╰─────────────────┴─────────────────┼─────────────────┼─────────────────┼────────────────────┤ ├────────────────────┼─────────────────┼─────────────────┼─────────────────┴─────────────────╯
                                        &kp C_MUTE        &kp C_PP          &kp C_STOP         ,   &none                &none             &none
//                                    ╰─────────────────┴─────────────────┴────────────────────╯ ╰────────────────────┴─────────────────┴─────────────────╯
)
